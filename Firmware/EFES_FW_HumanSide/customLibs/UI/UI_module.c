#include "main.h"
#include "UI_module.h"
#include "UI_private.h"
#include "App.h"
#include "tim.h"
#include "UI_home.h"
#include "UI_sensor.h"
#include "UI_steering.h"
#include "UI_settings.h"
#include "st7789.h"

typedef enum {
	RENDER_IDLE,
	RENDER_CLEAR,
	RENDER_PAGE
} UI_RenderPhase;

typedef struct {
	// Page currently allowed to use the display
	App_Page		page;

	// General status of the UI FSM
	UI_RenderPhase	phase;
	volatile bool	refresh_pending;

	// Main refresh period
	uint16_t		refresh_period_ms;
} UI_Context;

static UI_Context ui;

// =======================================================================
// UI public API
// =======================================================================

void UI_Init(void) {
	ui				= (UI_Context){0};	// Initialize the UI status as all 0's
	ui.phase		= RENDER_CLEAR;		// Start by clearing the Display

	// Initialize every page and its presentation data
	UI_Home_Init(APP_PAGE_HOME);
	UI_Sensor_Init(APP_PAGE_SENSOR);
	UI_Steering_Init(APP_PAGE_STEERING);
	UI_Settings_Init(APP_PAGE_SETTINGS);

	ui.refresh_period_ms = APP_REFRESH_DEFAULT_MS;
	
	// Initioalize the TIM6, used as repetitive timer to start the rendering of the
	// current page/situation of UI, with the period defined by the AppView refresh
	// rate field
	__HAL_TIM_CLEAR_FLAG(&htim6, TIM_FLAG_UPDATE);
	HAL_NVIC_ClearPendingIRQ(TIM6_DAC_IRQn);
	if (HAL_TIM_Base_Start_IT(&htim6) != HAL_OK) {
		Error_Handler();
	}
}



void UI_Process(void) {

	// Retrive the most recent App state
	App_View view;
	App_GetView(&view);

	// Check if the Rendering Frequency is changed
	if (view.UI_refresh_period_ms != ui.refresh_period_ms) {
		// If App requested a Rendering Frequency change, 
		// just change it in the UI state 
		UI_SetRefreshPeriod(view.UI_refresh_period_ms);
		ui.refresh_period_ms = view.UI_refresh_period_ms;	
		
		// Require an immediate re-render, in order to avoid long waits after 
		// rendering period change!
		ui.refresh_pending = true;	
	}

	// If the Page requested by the App changes, immediately start the procedure
	// to change page (do not wait for the current page to finish its rendering)
	if (view.page != ui.page) {
		ui.phase = RENDER_CLEAR;	// Before rendering the next page, clear it and start from a blank page!
	}

	if (ST7789_GetState() == ST7789_STATE_IDLE) {
		switch (ui.phase) {
			case RENDER_IDLE:
				// If there is no new request, remain in Idle and do nothing
				if (!ui.refresh_pending) break;
				
				ui.refresh_pending = false;					// Consume the refresh request
				ui.phase = RENDER_PAGE;						// Start rendering the page
				break;

			case RENDER_CLEAR:
				ui.page = view.page;						// Update the current page (still not rendered, but I'm already working to render it by clearing the page)
				
				ST7789_Fill_Color(UI_BACKGROUND);	// Fill the Page with the Background color (so it is a clean slate for the next page Rendering)
				
				ui.phase = RENDER_PAGE;				// Start rendering the page!
				
				break;

			case RENDER_PAGE:
				break;

		}
	}

	// Every page maintains its own data, even when it is not visible
	// Keep permission while DMA is busy so the selected page retains its snapshot
	bool draw = (ui.phase == RENDER_PAGE);
	bool home_finished		= UI_Home_Process		(&view, draw);
	bool sensor_finished	= UI_Sensor_Process		(&view, draw);
	bool steering_finished	= UI_Steering_Process	(&view, draw);
	bool settings_finished	= UI_Settings_Process	(&view, draw);

	// When the page finishes, wait for the next refresh request
	if (home_finished || sensor_finished || steering_finished || settings_finished) {
		ui.phase = RENDER_IDLE;
	}
}


void UI_SetRefreshPeriod(uint16_t period_ms) {
	// TIM6 is initialize with CubeMX, in order to generate and internal clock frequency of
	// 10 kHz, by prescaling the main MCU clock with the PSC prescaler register.
	// In practice, this timer can only count time multiples of 0.1ms.

	// Check that the requested period in ms can be actually implemented by the timer,
	// without over or underflow!
	if (period_ms == 0 || period_ms > 6553) {
		Error_Handler();
		return;
	}

	// Stop the Timer and disabilitate its possibility to generate Interrupt
	HAL_TIM_Base_Stop_IT(&htim6);

	// Set the Autoreload ARR register (when the Timer counter reaches that value, it 
	// generates as interrupt and starts counting from 0 again)
	// Period_Interrupt [s] = (PSC + 1) * (ARR + 1) / TIM6_clock [Hz]
	// Counter frequency = TIM6_clock / (PSC + 1) = 10000 Hz (10 ticks/ms)
	// 	--> Period_Interrupt [ms] = (ARR + 1) / 10 -> ARR = period_ms * 10 - 1
	__HAL_TIM_SET_AUTORELOAD	(&htim6, (uint32_t)period_ms * 10 - 1);		// Set the autoreload value ARR
	__HAL_TIM_SET_COUNTER		(&htim6, 0);									// Reset the main Timer counter 
	__HAL_TIM_CLEAR_FLAG		(&htim6, TIM_FLAG_UPDATE);						// Clear the timer flag that indicates that autoreload happened
	HAL_NVIC_ClearPendingIRQ(TIM6_DAC_IRQn);						// Clear previous Interrupts generated by the Timer 

	// Start the Timer and enable its possibility to generate Interrupts
	HAL_TIM_Base_Start_IT(&htim6);

}


void UI_RequestRefreshISR(void) {
	ui.refresh_pending = true;
}

bool UI_NeedsProcess(void) {
	return 	(ST7789_GetState() == ST7789_STATE_IDLE)			&&	// The ST7789 is free (it is possible to draw on display)
			((ui.phase != RENDER_IDLE) || (ui.refresh_pending));	// UI is not rendering anything OR a new render is requested
}
