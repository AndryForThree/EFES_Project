library ieee;
use ieee.std_logic_1164.all;
use ieee.numeric_std.all;

entity spi_slave is
	generic (
		DATA_WIDTH	: positive	:= 16;
		CPOL		: boolean	:= false;	-- Defines the SCLK signal level when communication is inactive
		CPHA		: boolean	:= false;	-- Defines if the sampling of MISO/MOSI is executed at leading (CPHA = 0) or trailing edge (CPHA = 1)
		LSB_FIRST	: boolean	:= false
	);
	port (
		rst_n_i			: in  std_logic;

		-- SPI Interface
		spi_sclk_i		: in  std_logic;		-- SPI Clock generated by Master
		spi_cs_n_i		: in  std_logic;		-- Device Select signal generated by master (this Slave is active when CS_n is low)
		spi_mosi_i		: in  std_logic;		-- Master Output Slave Input (basically the Serial Data Input for this slave)
		spi_miso_o		: out std_logic;		-- Master Input Slave Output (basically the Serial Data Output for this slave)

		-- TX Parallel Interface (User Logic (buffering system) -> SPI Core)
		tx_data_i		: in  std_logic_vector((DATA_WIDTH-1) downto 0);	-- Word to be transmitted 
		tx_valid_i		: in  std_logic;									-- Indicates that tx_data_i contains a valid word ready for transmission
		tx_request_o	: out std_logic;									-- Pop enable, sampled by the buffer on the TX update edge; hold tx_data_i/tx_valid_i until that edge

		-- RX Parallel Interface (SPI Core -> User Logic (buffering system))
		rx_data_o		: out std_logic_vector((DATA_WIDTH-1) downto 0);	-- Word received from SPI
		rx_valid_o		: out std_logic										-- Request the buffering system to store the received word
	);
end entity spi_slave;



architecture rtl of spi_slave is

	-- SPI Clock Edge Configuration
	constant SAMPLE_ON_RISING : boolean := (CPOL = CPHA);

	-- Serial Communication Shift Registers
	signal tx_shift_reg	: std_logic_vector(DATA_WIDTH-1 downto 0);
	signal rx_shift_reg	: std_logic_vector(DATA_WIDTH-1 downto 0);

	-- Combinatorial RX Word
	signal rx_next_word	: std_logic_vector(DATA_WIDTH-1 downto 0);

	-- Bit Counter
	signal bit_count	: natural range 0 to DATA_WIDTH-1;

	-- TX Control
	signal tx_first_bit		: std_logic;	-- Defines if the current SPI Cycle is the first!
	signal tx_word_valid	: std_logic;	-- Defines if the current TX Word was valid from Buffering System 

begin

	-- Each word must contain at least 2 bits.
	assert DATA_WIDTH >= 2
		report "SPI: DATA_WIDTH must be at least 2"
		severity failure;

	-- RX Word Construction
	process(rx_shift_reg, spi_mosi_i)
		variable next_word : std_logic_vector((DATA_WIDTH-1) downto 0);
	begin
		if LSB_FIRST then
			-- LSB must be sent in as the first bit in MOSI, so shift the register to the right
			next_word := std_logic_vector(shift_right(unsigned(rx_shift_reg), 1));	-- Shift right the Shift Register
			next_word(DATA_WIDTH-1) := spi_mosi_i;									-- Insert MOSI at the MSB
		else
			-- MSB must be sent in as the first bit in MOSI, so shift the register to the left
			next_word := std_logic_vector(shift_left(unsigned(rx_shift_reg), 1));	-- Shift left the Shift Register
			next_word(0) := spi_mosi_i;												-- Insert MOSI at the LSB
		end if;

		-- Compute the next value of the RX_shift register
		rx_next_word <= next_word;
	end process;

	-- RX Parallel Interface
	rx_data_o 	<= rx_next_word;
	rx_valid_o 	<=	'1'	when	(spi_cs_n_i = '0')			and 	-- The SPI Slave is enabled
								(rst_n_i = '1')				and 	-- The SPI Slave is enabled
								(bit_count = DATA_WIDTH-1)	else 	-- N-1 bits have been sampled; the last bit is available on MOSI
					'0';

	-- RX Sampling
	process(spi_sclk_i, spi_cs_n_i, rst_n_i)
	begin
		if rst_n_i = '0' or spi_cs_n_i = '1' then
			rx_shift_reg	<= (others => '0');
			bit_count		<= 0;
			tx_word_valid	<= '0';

		elsif (SAMPLE_ON_RISING and rising_edge(spi_sclk_i))		or
			  (not SAMPLE_ON_RISING and falling_edge(spi_sclk_i))	then

			-- Update the shift Register with the next word computed combinatorially
			rx_shift_reg <= rx_next_word;

			-- Capture TX availability at the first bit of each word
			if (not CPHA) and (bit_count = 0) then
				tx_word_valid <= tx_valid_i;
			end if;

			-- Update the sampling counter 
			if bit_count = DATA_WIDTH-1 then
				bit_count <= 0;
			else
				bit_count <= bit_count + 1;
			end if;
		end if;
	end process;

	-- TX Parallel Interface
	tx_request_o <= '1' when
						(rst_n_i = '1') and
						(spi_cs_n_i = '0') and
						(	
							-- Sample a Word from TX Data if there is one at the first Cycle
							(CPHA and (bit_count = 0) and (tx_valid_i = '1')) or
							((not CPHA) and (tx_word_valid = '1') and
								(bit_count = 1))
						)
					else '0';

	-- TX Shift Register
	process(spi_sclk_i, spi_cs_n_i, rst_n_i)
	begin
		if (rst_n_i = '0') or (spi_cs_n_i = '1') then
			tx_shift_reg <= (others => '0');
			tx_first_bit <= '1';

		-- Check the active edge for SPI Transmission (TX Update Edge). 
		-- At the active edge, the Slave must update the MISO.
		-- This edge is the opposite edge in which the Master is sampling the MISO,
		-- in order to reduce timing problems between the two units
		elsif (SAMPLE_ON_RISING and falling_edge(spi_sclk_i)) or
			  ((not SAMPLE_ON_RISING) and rising_edge(spi_sclk_i)) then

			-- Track the first bit on the TX update edge
			if bit_count = 0 then
				tx_first_bit <= '1';
			else
				tx_first_bit <= '0';
			end if;

			if CPHA then
				if bit_count = 0 then
					-- If this is the first TX Update Edge of the word, before any TX Sampling
					-- Load a complete word on on the first TX Update edge
					-- If there is no word available from the buffering system, just upload
					-- a word of all 0s (MISO will transmit all 0s)!! 
					if tx_valid_i = '1' then
						tx_shift_reg <= tx_data_i;
					else
						tx_shift_reg <= (others => '0');
					end if;
				else
					-- If this is NOT the first TX Update Edge of the word, just shift the
					-- shift register to update the bit to be sent in MISO!
					if LSB_FIRST then
						tx_shift_reg <= std_logic_vector(shift_right(unsigned(tx_shift_reg), 1));
					else
						tx_shift_reg <= std_logic_vector(shift_left(unsigned(tx_shift_reg), 1));
					end if;
				end if;
			else
				-- If CPHA = 0, the first TX Update Edge comes after the first TX Sampling Edge, and so
				-- the first bit of the TX Data is already consumed! Put in the shift register only the 
				-- already shifted version of the TX Data!!
				if (bit_count = 1) then
					if tx_word_valid = '1' then
						if LSB_FIRST then
							tx_shift_reg <= std_logic_vector(shift_right(unsigned(tx_data_i), 1));
						else
							tx_shift_reg <= std_logic_vector(shift_left(unsigned(tx_data_i), 1));
						end if;
					else
						tx_shift_reg <= (others => '0');
					end if;

				-- If this is not the first TX Update Edge, simply Update the Shift Register!
				else 
					if LSB_FIRST then
						tx_shift_reg <= std_logic_vector(shift_right(unsigned(tx_shift_reg), 1));
					else
						tx_shift_reg <= std_logic_vector(shift_left(unsigned(tx_shift_reg), 1));
					end if;
				end if;
			end if;
		end if;
	end process;

	-- MISO Output
	-- In general the MISO MISO output must be handled in the following way:
	--	- If the slave is not active or selected	
	--			--> MISO must be High Impedance
	--	- If the salve is selected and active, but no TX data is ready to be sent
	--			-->	MISO must trasmit all zeros 
	--	- If the slave is selected and active, and TX data is ready to be sent:
	--			--> MISO is fed from the TX Shift Register at each SPI Clock Cycle
	-- In the case of CPHA = 0, at the first SPI Clock Edge generated by the master,
	-- the signal in MISO is sampled, and so it is necessary that the data must be
	-- ready in MISO even before any clock activity from Master!!
	process(rst_n_i, spi_cs_n_i, tx_first_bit, tx_valid_i, tx_data_i, tx_shift_reg)
	begin
		-- BY default, the MISO (Serial Output of the Slave), is a shared bus between all
		-- slaves, and so it is necessary that if the Slave is not selected, it must 
		-- use a High Impedance output for it!!
		spi_miso_o <= 'Z';

		if (rst_n_i = '1') and (spi_cs_n_i = '0') then
			if (not CPHA) and (tx_first_bit = '1') then
				if tx_valid_i = '1' then
					if LSB_FIRST then
						-- MISO is fed by the LSB of the TX Data In bus
						spi_miso_o <= tx_data_i(0);			
					else
						-- MISO is fed by the MSB of the TX Data In bus
						spi_miso_o <= tx_data_i(DATA_WIDTH-1);
					end if;
				else
					-- MISO is 0 because the Slave is active and selected, but there
					-- is no data ready to be send from Slave to Master
					spi_miso_o <= '0';
				end if;

			else
				-- If there are no special cases to be handled, the MISO is connected directly
				-- to the head of the TX Shift Register
				if LSB_FIRST then
					spi_miso_o <= tx_shift_reg(0);
				else
					spi_miso_o <= tx_shift_reg(DATA_WIDTH-1);
				end if;
			end if;
		end if;
	end process;

end architecture rtl;
